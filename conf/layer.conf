## conf/layer.conf
```bitbake
#
# Copyright (C) 2020 Wind River Systems, Inc.
#

# We have a conf and classes directory, add to BBPATH
BBPATH =. "${LAYERDIR}:"

# We have a packages directory, add to BBFILES
BSP_NXP_LS1046_DERIVED ??=""
BBFILES += "${@bb.utils.contains('MACHINE', 'nxp-ls1046 ${BSP_NXP_LS1046_DERIVED}', '${LAYERDIR}/recipes-*/*/*.bb', '', d)}"
BBFILES += "${@bb.utils.contains('MACHINE', 'nxp-ls1046 ${BSP_NXP_LS1046_DERIVED}', '${LAYERDIR}/recipes-*/*/*.bbappend', '', d)}"

BBFILE_COLLECTIONS += "wr-nxp-ls1046"
BBFILE_PATTERN_wr-nxp-ls1046 = "^${LAYERDIR}/"
BBFILE_PRIORITY_wr-nxp-ls1046 = "7"

# This should only be incremented on significant changes that will
# cause compatibility issues with other layers
LAYERVERSION_wr-nxp-ls1046 = "1"

LAYERDEPENDS_wr-nxp-ls1046 = "core wrlinux freescale-layer"

LAYERSERIES_COMPAT_wr-nxp-ls1046 = "wrl zeus"
```

## conf/machine/ls1046.inc
```bitbake
#@TYPE: Machine inc.
#@NAME: nxp-ls1046 layer

DEFAULTTUNE = "cortexa72"
require conf/machine/include/tune-cortexa72.inc

MACHINE_FEATURES += "usbhost jffs2 ext2 alsa vfat"

KERNEL_IMAGETYPE = "Image"

SERIAL_CONSOLE = "115200 ttyS0"

IMAGE_FSTYPES += "tar.bz2 wic wic.bmap"
WKS_FILE = "nxp-ls1046-sdimage.wks"
IMAGE_INSTALL_append = " kernel-devicetree kernel-image-image"
do_image_wic[depends] += "mtools-native:do_populate_sysroot dosfstools-native:do_populate_sysroot"

# multilib support
MULTILIBS ?= "multilib:lib32"
DEFAULTTUNE_virtclass-multilib-lib32 ?= "armv7athf-neon"

EXTRA_IMAGEDEPENDS = "u-boot-qoriq u-boot-uenv"
UBOOT_CONFIG ??= "sdcard qspi"
UBOOT_CONFIG[sdcard] = "ls1046ardb_sdcard_config,,u-boot-with-spl-pbl.bin"
UBOOT_CONFIG[qspi] = "ls1046ardb_qspi_config,,u-boot-dtb.bin"

# it's used by many recipes in meta-freescale
MACHINE_SOCARCH = "${TUNE_PKGARCH}"

# pull in the meta-freescale layer.
BSP_NXP_DERIVED_append_nxp-ls1046  = " nxp-ls1046"

PREFERRED_PROVIDER_virtual/kernel ??= "linux-yocto"
```

## conf/machine/nxp-ls1046.conf
```bitbake
#@TYPE: Machine
#@NAME: nxp-ls1046
#@DESCRIPTION: Machine configuration for running a nxp-ls1046

require ls1046.inc

EXTRA_IMAGECMD_jffs2 ?= "--pad --eraseblock=128"
```

## wic/nxp-ls1046-sdimage.wks
```
# short-description: Create a ls1046 disk image (SD card)
# long-description: Create a partitioned disk image for NXP ls1046
# The first partition is NULL, reserved for uboot.
# The second partition is to accommodate kernel, dtb and rootfs.

# u-boot and series firmwares will be directly burned with NXP pre-build image

part / --source rootfs --ondisk mmcblk --fstype=ext4 --label root --align 61440
```
